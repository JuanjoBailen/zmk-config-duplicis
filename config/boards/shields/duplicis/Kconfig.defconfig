## config/boards/shields/duplicis/Kconfig.defconfig
```kconfig
if SHIELD_DUPLICIS_LEFT

config ZMK_KEYBOARD_NAME
    default "Duplicis"

config ZMK_SPLIT_ROLE_CENTRAL
    default y

endif

if SHIELD_DUPLICIS_LEFT || SHIELD_DUPLICIS_RIGHT

config ZMK_SPLIT
    default y

endif
```

## config/boards/shields/duplicis/Kconfig.shield
```kconfig
config SHIELD_DUPLICIS_LEFT
    def_bool $(shields_list_contains,duplicis_left)

config SHIELD_DUPLICIS_RIGHT
    def_bool $(shields_list_contains,duplicis_right)
    
```
